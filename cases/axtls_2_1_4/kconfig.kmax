## cases/axtls_2_1_4/kconfig.kmax
```kconfig
config CONFIG_HTTP_TIMEOUT number
prompt CONFIG_HTTP_TIMEOUT (CONFIG_AXHTTPD)
def_nonbool CONFIG_HTTP_TIMEOUT "300"|(CONFIG_AXHTTPD)
config CONFIG_SSL_X509_ORGANIZATION_NAME string
prompt CONFIG_SSL_X509_ORGANIZATION_NAME (CONFIG_SSL_GENERATE_X509_CERT)
config CONFIG_SSL_SERVER_ONLY bool
prompt CONFIG_SSL_SERVER_ONLY (1)
config CONFIG_JAVA_HOME string
prompt CONFIG_JAVA_HOME (CONFIG_JAVA_BINDINGS)
def_nonbool CONFIG_JAVA_HOME "c:\Program Files\Java\jdk1.5.0_06"|(CONFIG_JAVA_BINDINGS and (CONFIG_PLATFORM_WIN32 or CONFIG_PLATFORM_CYGWIN))
def_nonbool CONFIG_JAVA_HOME "/usr/lib/jvm/java-7-openjdk-amd64"|(CONFIG_JAVA_BINDINGS and  not CONFIG_PLATFORM_WIN32 and  not CONFIG_PLATFORM_CYGWIN)
config CONFIG_SSL_TEST bool
prompt CONFIG_SSL_TEST (CONFIG_SSL_FULL_MODE and  not CONFIG_SSL_GENERATE_X509_CERT)
def_bool CONFIG_SSL_TEST 0 (CONFIG_SSL_FULL_MODE and  not CONFIG_SSL_GENERATE_X509_CERT)
config CONFIG_SSL_PROT_LOW bool
prompt CONFIG_SSL_PROT_LOW (1)
config CONFIG_DOT_NET_FRAMEWORK_BASE string
prompt CONFIG_DOT_NET_FRAMEWORK_BASE (CONFIG_CSHARP_BINDINGS or CONFIG_VBNET_BINDINGS)
def_nonbool CONFIG_DOT_NET_FRAMEWORK_BASE "c:\WINDOWS\Microsoft.NET\Framework\v2.0.50727"|(CONFIG_CSHARP_BINDINGS or CONFIG_VBNET_BINDINGS)
config CONFIG_HTTP_DIRECTORIES bool
prompt CONFIG_HTTP_DIRECTORIES (CONFIG_AXHTTPD)
def_bool CONFIG_HTTP_DIRECTORIES 1 (CONFIG_AXHTTPD)
config CONFIG_PERL_CORE string
prompt CONFIG_PERL_CORE (CONFIG_PERL_BINDINGS and CONFIG_PLATFORM_WIN32)
def_nonbool CONFIG_PERL_CORE "c:\perl\lib\CORE"|(CONFIG_PERL_BINDINGS and CONFIG_PLATFORM_WIN32)
config CONFIG_VBNET_SAMPLES bool
prompt CONFIG_VBNET_SAMPLES (CONFIG_SAMPLES and CONFIG_VBNET_BINDINGS)
def_bool CONFIG_VBNET_SAMPLES 1 (CONFIG_SAMPLES and CONFIG_VBNET_BINDINGS)
config CONFIG_CSHARP_SAMPLES bool
prompt CONFIG_CSHARP_SAMPLES (CONFIG_SAMPLES and CONFIG_CSHARP_BINDINGS)
def_bool CONFIG_CSHARP_SAMPLES 1 (CONFIG_SAMPLES and CONFIG_CSHARP_BINDINGS)
config CONFIG_SSL_EXPIRY_TIME number
prompt CONFIG_SSL_EXPIRY_TIME ( not CONFIG_SSL_SKELETON_MODE)
def_nonbool CONFIG_SSL_EXPIRY_TIME "24"|( not CONFIG_SSL_SKELETON_MODE)
config CONFIG_PERL_BINDINGS bool
prompt CONFIG_PERL_BINDINGS (CONFIG_BINDINGS)
def_bool CONFIG_PERL_BINDINGS 0 (CONFIG_BINDINGS)
config CONFIG_PLATFORM_WIN32 bool
prompt CONFIG_PLATFORM_WIN32 (1)
config CONFIG_SSL_MAX_CERTS number
prompt CONFIG_SSL_MAX_CERTS (1)
def_nonbool CONFIG_SSL_MAX_CERTS "3"|(1)
config CONFIG_AXTLSWRAP bool
prompt CONFIG_AXTLSWRAP ( not CONFIG_PLATFORM_WIN32)
def_bool CONFIG_AXTLSWRAP 0 ( not CONFIG_PLATFORM_WIN32)
config CONFIG_EXTRA_CFLAGS_OPTIONS string
prompt CONFIG_EXTRA_CFLAGS_OPTIONS (1)
config CONFIG_BIGINT_BARRETT bool
prompt CONFIG_BIGINT_BARRETT (1)
config CONFIG_C_SAMPLES bool
prompt CONFIG_C_SAMPLES (CONFIG_SAMPLES)
def_bool CONFIG_C_SAMPLES 1 (CONFIG_SAMPLES)
config HAVE_DOT_CONFIG bool
def_bool HAVE_DOT_CONFIG 1 (1)
config CONFIG_BIGINT_CLASSICAL bool
prompt CONFIG_BIGINT_CLASSICAL (1)
config CONFIG_JAVA_SAMPLES bool
prompt CONFIG_JAVA_SAMPLES (CONFIG_SAMPLES and CONFIG_JAVA_BINDINGS)
def_bool CONFIG_JAVA_SAMPLES 1 (CONFIG_SAMPLES and CONFIG_JAVA_BINDINGS)
config MUL_KARATSUBA_THRESH number
prompt MUL_KARATSUBA_THRESH ( not CONFIG_SSL_SKELETON_MODE and CONFIG_BIGINT_KARATSUBA)
def_nonbool MUL_KARATSUBA_THRESH "20"|( not CONFIG_SSL_SKELETON_MODE and CONFIG_BIGINT_KARATSUBA)
config CONFIG_DEBUG bool
prompt CONFIG_DEBUG (1)
def_bool CONFIG_DEBUG 0 (1)
config CONFIG_VISUAL_STUDIO_10_0_BASE string
prompt CONFIG_VISUAL_STUDIO_10_0_BASE (CONFIG_PLATFORM_WIN32 and CONFIG_VISUAL_STUDIO_10_0)
def_nonbool CONFIG_VISUAL_STUDIO_10_0_BASE "c:\Program Files\Microsoft Visual Studio 10.0"|(CONFIG_PLATFORM_WIN32 and CONFIG_VISUAL_STUDIO_10_0)
config CONFIG_LUA_SAMPLES bool
prompt CONFIG_LUA_SAMPLES (CONFIG_SAMPLES and CONFIG_LUA_BINDINGS)
def_bool CONFIG_LUA_SAMPLES 1 (CONFIG_SAMPLES and CONFIG_LUA_BINDINGS)
config CONFIG_SSL_PROT_MEDIUM bool
prompt CONFIG_SSL_PROT_MEDIUM (1)
config CONFIG_AXHTTPD bool
prompt CONFIG_AXHTTPD (1)
def_bool CONFIG_AXHTTPD 1 (1)
config CONFIG_SSL_GENERATE_X509_CERT bool
prompt CONFIG_SSL_GENERATE_X509_CERT (1)
def_bool CONFIG_SSL_GENERATE_X509_CERT 0 (1)
config CONFIG_SSL_USE_PKCS12 bool
prompt CONFIG_SSL_USE_PKCS12 ( not CONFIG_SSL_SKELETON_MODE)
def_bool CONFIG_SSL_USE_PKCS12 0 ( not CONFIG_SSL_SKELETON_MODE and  not CONFIG_SSL_FULL_MODE)
def_bool CONFIG_SSL_USE_PKCS12 1 ( not CONFIG_SSL_SKELETON_MODE and CONFIG_SSL_FULL_MODE)
config CONFIG_X509_MAX_CA_CERTS number
prompt CONFIG_X509_MAX_CA_CERTS ( not CONFIG_SSL_SERVER_ONLY and  not CONFIG_SSL_SKELETON_MODE)
def_nonbool CONFIG_X509_MAX_CA_CERTS "150"|( not CONFIG_SSL_SERVER_ONLY and  not CONFIG_SSL_SKELETON_MODE)
config CONFIG_VISUAL_STUDIO_8_0_BASE string
prompt CONFIG_VISUAL_STUDIO_8_0_BASE (CONFIG_PLATFORM_WIN32 and CONFIG_VISUAL_STUDIO_8_0)
def_nonbool CONFIG_VISUAL_STUDIO_8_0_BASE "c:\Program Files\Microsoft Visual Studio 8"|(CONFIG_PLATFORM_WIN32 and CONFIG_VISUAL_STUDIO_8_0)
config PREFIX string
prompt PREFIX ( not CONFIG_PLATFORM_WIN32)
def_nonbool PREFIX "/usr/local"|( not CONFIG_PLATFORM_WIN32)
config CONFIG_VISUAL_STUDIO_8_0 bool
prompt CONFIG_VISUAL_STUDIO_8_0 (1)
config CONFIG_SSL_X509_CERT_LOCATION string
prompt CONFIG_SSL_X509_CERT_LOCATION ( not CONFIG_SSL_GENERATE_X509_CERT and  not CONFIG_SSL_USE_DEFAULT_KEY and  not CONFIG_SSL_SKELETON_MODE)
config CONFIG_VBNET_BINDINGS bool
prompt CONFIG_VBNET_BINDINGS (CONFIG_BINDINGS)
def_bool CONFIG_VBNET_BINDINGS 0 (CONFIG_BINDINGS)
config CONFIG_SSL_FULL_MODE bool
prompt CONFIG_SSL_FULL_MODE (1)
config CONFIG_BIGINT_MONTGOMERY bool
prompt CONFIG_BIGINT_MONTGOMERY (1)
config CONFIG_HTTP_PORT number
prompt CONFIG_HTTP_PORT (CONFIG_AXHTTPD)
def_nonbool CONFIG_HTTP_PORT "80"|(CONFIG_AXHTTPD)
config CONFIG_HTTP_HTTPS_PORT number
prompt CONFIG_HTTP_HTTPS_PORT (CONFIG_AXHTTPD)
def_nonbool CONFIG_HTTP_HTTPS_PORT "443"|(CONFIG_AXHTTPD)
config CONFIG_SSL_CTX_MUTEXING bool
prompt CONFIG_SSL_CTX_MUTEXING (1)
def_bool CONFIG_SSL_CTX_MUTEXING 0 (1)
config CONFIG_CSHARP_BINDINGS bool
prompt CONFIG_CSHARP_BINDINGS (CONFIG_BINDINGS)
def_bool CONFIG_CSHARP_BINDINGS 0 (CONFIG_BINDINGS)
config CONFIG_HTTP_LUA_PREFIX string
prompt CONFIG_HTTP_LUA_PREFIX (CONFIG_AXHTTPD and  not CONFIG_PLATFORM_WIN32 and CONFIG_HTTP_ENABLE_LUA)
def_nonbool CONFIG_HTTP_LUA_PREFIX "/usr"|(CONFIG_AXHTTPD and  not CONFIG_PLATFORM_WIN32 and CONFIG_HTTP_ENABLE_LUA)
config CONFIG_SSL_SKELETON_MODE bool
prompt CONFIG_SSL_SKELETON_MODE (1)
config CONFIG_BIGINT_SQUARE bool
prompt CONFIG_BIGINT_SQUARE ( not CONFIG_SSL_SKELETON_MODE)
def_bool CONFIG_BIGINT_SQUARE 1 ( not CONFIG_SSL_SKELETON_MODE)
config CONFIG_USE_DEV_URANDOM bool
prompt CONFIG_USE_DEV_URANDOM ( not CONFIG_PLATFORM_WIN32)
def_bool CONFIG_USE_DEV_URANDOM 1 ( not CONFIG_PLATFORM_WIN32)
config CONFIG_PERL_SAMPLES bool
prompt CONFIG_PERL_SAMPLES (CONFIG_SAMPLES and CONFIG_PERL_BINDINGS)
def_bool CONFIG_PERL_SAMPLES 1 (CONFIG_SAMPLES and CONFIG_PERL_BINDINGS)
config CONFIG_HTTP_BUILD_LUA bool
prompt CONFIG_HTTP_BUILD_LUA (CONFIG_AXHTTPD and  not CONFIG_PLATFORM_WIN32 and CONFIG_HTTP_ENABLE_LUA)
def_bool CONFIG_HTTP_BUILD_LUA 0 (CONFIG_AXHTTPD and  not CONFIG_PLATFORM_WIN32 and CONFIG_HTTP_ENABLE_LUA)
config CONFIG_VISUAL_STUDIO_10_0 bool
prompt CONFIG_VISUAL_STUDIO_10_0 (1)
config CONFIG_PERFORMANCE_TESTING bool
prompt CONFIG_PERFORMANCE_TESTING (CONFIG_SSL_CERT_VERIFICATION)
def_bool CONFIG_PERFORMANCE_TESTING 0 (CONFIG_SSL_CERT_VERIFICATION)
config SQU_KARATSUBA_THRESH number
prompt SQU_KARATSUBA_THRESH ( not CONFIG_SSL_SKELETON_MODE and CONFIG_BIGINT_KARATSUBA and CONFIG_BIGINT_SQUARE)
def_nonbool SQU_KARATSUBA_THRESH "40"|( not CONFIG_SSL_SKELETON_MODE and CONFIG_BIGINT_KARATSUBA and CONFIG_BIGINT_SQUARE)
config CONFIG_EXTRA_LDFLAGS_OPTIONS string
prompt CONFIG_EXTRA_LDFLAGS_OPTIONS (1)
config CONFIG_STRIP_UNWANTED_SECTIONS bool
prompt CONFIG_STRIP_UNWANTED_SECTIONS ( not CONFIG_PLATFORM_WIN32 and  not CONFIG_DEBUG)
def_bool CONFIG_STRIP_UNWANTED_SECTIONS 1 ( not CONFIG_PLATFORM_WIN32 and  not CONFIG_DEBUG)
config CONFIG_SSL_ENABLE_CLIENT bool
prompt CONFIG_SSL_ENABLE_CLIENT (1)
config CONFIG_SSL_USE_DEFAULT_KEY bool
prompt CONFIG_SSL_USE_DEFAULT_KEY ( not CONFIG_SSL_SKELETON_MODE)
def_bool CONFIG_SSL_USE_DEFAULT_KEY 1 ( not CONFIG_SSL_SKELETON_MODE)
config CONFIG_SSL_CERT_VERIFICATION bool
prompt CONFIG_SSL_CERT_VERIFICATION (1)
config CONFIG_HTTP_WEBROOT string
prompt CONFIG_HTTP_WEBROOT (CONFIG_AXHTTPD)
def_nonbool CONFIG_HTTP_WEBROOT "../www"|(CONFIG_AXHTTPD and  not CONFIG_PLATFORM_WIN32)
def_nonbool CONFIG_HTTP_WEBROOT "..\www"|(CONFIG_AXHTTPD and CONFIG_PLATFORM_WIN32)
config CONFIG_HTTP_STATIC_BUILD bool
prompt CONFIG_HTTP_STATIC_BUILD (CONFIG_AXHTTPD)
def_bool CONFIG_HTTP_STATIC_BUILD 0 (CONFIG_AXHTTPD)
config CONFIG_HTTP_SESSION_CACHE_SIZE number
prompt CONFIG_HTTP_SESSION_CACHE_SIZE (CONFIG_AXHTTPD)
def_nonbool CONFIG_HTTP_SESSION_CACHE_SIZE "5"|(CONFIG_AXHTTPD)
config CONFIG_HTTP_CGI_EXTENSIONS string
prompt CONFIG_HTTP_CGI_EXTENSIONS (CONFIG_AXHTTPD and  not CONFIG_PLATFORM_WIN32 and CONFIG_HTTP_HAS_CGI)
def_nonbool CONFIG_HTTP_CGI_EXTENSIONS ".lua,.lp,.php"|(CONFIG_AXHTTPD and  not CONFIG_PLATFORM_WIN32 and CONFIG_HTTP_HAS_CGI)
config CONFIG_OPENSSL_COMPATIBLE bool
prompt CONFIG_OPENSSL_COMPATIBLE (1)
def_bool CONFIG_OPENSSL_COMPATIBLE 0 (1)
config CONFIG_BIGINT_SLIDING_WINDOW bool
prompt CONFIG_BIGINT_SLIDING_WINDOW ( not CONFIG_SSL_SKELETON_MODE)
def_bool CONFIG_BIGINT_SLIDING_WINDOW 1 ( not CONFIG_SSL_SKELETON_MODE)
config CONFIG_VISUAL_STUDIO_7_0 bool
prompt CONFIG_VISUAL_STUDIO_7_0 (1)
config CONFIG_BIGINT_KARATSUBA bool
prompt CONFIG_BIGINT_KARATSUBA ( not CONFIG_SSL_SKELETON_MODE)
def_bool CONFIG_BIGINT_KARATSUBA 0 ( not CONFIG_SSL_SKELETON_MODE)
config CONFIG_BIGINT_CRT bool
prompt CONFIG_BIGINT_CRT ( not CONFIG_SSL_SKELETON_MODE)
def_bool CONFIG_BIGINT_CRT 1 ( not CONFIG_SSL_SKELETON_MODE)
config CONFIG_HTTP_USER string
prompt CONFIG_HTTP_USER (CONFIG_AXHTTPD and CONFIG_HTTP_ENABLE_DIFFERENT_USER)
def_nonbool CONFIG_HTTP_USER "nobody"|(CONFIG_AXHTTPD and CONFIG_HTTP_ENABLE_DIFFERENT_USER)
config CONFIG_LUA_CORE string
prompt CONFIG_LUA_CORE (CONFIG_LUA_BINDINGS)
def_nonbool CONFIG_LUA_CORE "/usr/local"|(CONFIG_LUA_BINDINGS)
config CONFIG_VISUAL_STUDIO_7_0_BASE string
prompt CONFIG_VISUAL_STUDIO_7_0_BASE (CONFIG_PLATFORM_WIN32 and CONFIG_VISUAL_STUDIO_7_0)
def_nonbool CONFIG_VISUAL_STUDIO_7_0_BASE "c:\Program Files\Microsoft Visual Studio .NET 2003"|(CONFIG_PLATFORM_WIN32 and CONFIG_VISUAL_STUDIO_7_0)
config CONFIG_HTTP_HAS_CGI bool
prompt CONFIG_HTTP_HAS_CGI (CONFIG_AXHTTPD and  not CONFIG_PLATFORM_WIN32)
def_bool CONFIG_HTTP_HAS_CGI 1 (CONFIG_AXHTTPD and  not CONFIG_PLATFORM_WIN32)
config CONFIG_PERL_LIB string
prompt CONFIG_PERL_LIB (CONFIG_PERL_BINDINGS and CONFIG_PLATFORM_WIN32)
def_nonbool CONFIG_PERL_LIB "perl58.lib"|(CONFIG_PERL_BINDINGS and CONFIG_PLATFORM_WIN32)
config CONFIG_INTEGER_32BIT bool
prompt CONFIG_INTEGER_32BIT (1)
config CONFIG_BINDINGS bool
prompt CONFIG_BINDINGS (1)
def_bool CONFIG_BINDINGS 0 (1)
config CONFIG_HTTP_HAS_IPV6 bool
prompt CONFIG_HTTP_HAS_IPV6 (CONFIG_AXHTTPD and  not CONFIG_PLATFORM_WIN32)
def_bool CONFIG_HTTP_HAS_IPV6 0 (CONFIG_AXHTTPD and  not CONFIG_PLATFORM_WIN32)
config CONFIG_PLATFORM_CYGWIN bool
prompt CONFIG_PLATFORM_CYGWIN (1)
config CONFIG_SSL_PRIVATE_KEY_LOCATION string
prompt CONFIG_SSL_PRIVATE_KEY_LOCATION ( not CONFIG_SSL_USE_DEFAULT_KEY and  not CONFIG_SSL_SKELETON_MODE)
config CONFIG_LUA_BINDINGS bool
prompt CONFIG_LUA_BINDINGS (CONFIG_BINDINGS and  not CONFIG_PLATFORM_WIN32)
def_bool CONFIG_LUA_BINDINGS 0 (CONFIG_BINDINGS and  not CONFIG_PLATFORM_WIN32)
config CONFIG_HTTP_HAS_AUTHORIZATION bool
prompt CONFIG_HTTP_HAS_AUTHORIZATION (CONFIG_AXHTTPD)
def_bool CONFIG_HTTP_HAS_AUTHORIZATION 1 (CONFIG_AXHTTPD)
config CONFIG_INTEGER_8BIT bool
prompt CONFIG_INTEGER_8BIT (1)
config CONFIG_HTTP_ENABLE_LUA bool
prompt CONFIG_HTTP_ENABLE_LUA (CONFIG_AXHTTPD and  not CONFIG_PLATFORM_WIN32 and CONFIG_HTTP_HAS_CGI)
def_bool CONFIG_HTTP_ENABLE_LUA 1 (CONFIG_AXHTTPD and  not CONFIG_PLATFORM_WIN32 and CONFIG_HTTP_HAS_CGI)
config CONFIG_JAVA_BINDINGS bool
prompt CONFIG_JAVA_BINDINGS (CONFIG_BINDINGS)
def_bool CONFIG_JAVA_BINDINGS 0 (CONFIG_BINDINGS)
config CONFIG_SSL_X509_ORGANIZATION_UNIT_NAME string
prompt CONFIG_SSL_X509_ORGANIZATION_UNIT_NAME (CONFIG_SSL_GENERATE_X509_CERT)
config CONFIG_HTTP_ENABLE_DIFFERENT_USER bool
prompt CONFIG_HTTP_ENABLE_DIFFERENT_USER (CONFIG_AXHTTPD and  not CONFIG_PLATFORM_WIN32)
def_bool CONFIG_HTTP_ENABLE_DIFFERENT_USER 0 (CONFIG_AXHTTPD and  not CONFIG_PLATFORM_WIN32)
config CONFIG_BIGINT_CHECK_ON bool
prompt CONFIG_BIGINT_CHECK_ON ( not CONFIG_SSL_SKELETON_MODE)
def_bool CONFIG_BIGINT_CHECK_ON 0 ( not CONFIG_SSL_SKELETON_MODE and  not CONFIG_DEBUG)
def_bool CONFIG_BIGINT_CHECK_ON 1 ( not CONFIG_SSL_SKELETON_MODE and CONFIG_DEBUG)
config CONFIG_INTEGER_16BIT bool
prompt CONFIG_INTEGER_16BIT (1)
config CONFIG_SAMPLES bool
prompt CONFIG_SAMPLES (1)
def_bool CONFIG_SAMPLES 1 (1)
config CONFIG_SSL_X509_COMMON_NAME string
prompt CONFIG_SSL_X509_COMMON_NAME (CONFIG_SSL_GENERATE_X509_CERT)
config CONFIG_PLATFORM_LINUX bool
prompt CONFIG_PLATFORM_LINUX (1)
config CONFIG_HTTP_IS_DAEMON bool
prompt CONFIG_HTTP_IS_DAEMON (CONFIG_AXHTTPD and  not CONFIG_PLATFORM_WIN32)
def_bool CONFIG_HTTP_IS_DAEMON 0 (CONFIG_AXHTTPD and  not CONFIG_PLATFORM_WIN32)
config CONFIG_SSL_PROT_HIGH bool
prompt CONFIG_SSL_PROT_HIGH (1)
config CONFIG_HTTP_VERBOSE bool
prompt CONFIG_HTTP_VERBOSE (CONFIG_AXHTTPD)
def_bool CONFIG_HTTP_VERBOSE 1 (CONFIG_AXHTTPD and CONFIG_SSL_FULL_MODE)
def_bool CONFIG_HTTP_VERBOSE 0 (CONFIG_AXHTTPD and  not CONFIG_SSL_FULL_MODE)
config CONFIG_SSL_HAS_PEM bool
prompt CONFIG_SSL_HAS_PEM ( not CONFIG_SSL_SKELETON_MODE)
def_bool CONFIG_SSL_HAS_PEM 0 ( not CONFIG_SSL_SKELETON_MODE and  not CONFIG_SSL_FULL_MODE)
def_bool CONFIG_SSL_HAS_PEM 1 ( not CONFIG_SSL_SKELETON_MODE and CONFIG_SSL_FULL_MODE)
config CONFIG_HTTP_CGI_LAUNCHER string
prompt CONFIG_HTTP_CGI_LAUNCHER (CONFIG_AXHTTPD and  not CONFIG_PLATFORM_WIN32 and CONFIG_HTTP_HAS_CGI)
def_nonbool CONFIG_HTTP_CGI_LAUNCHER "/usr/bin/cgi"|(CONFIG_AXHTTPD and  not CONFIG_PLATFORM_WIN32 and CONFIG_HTTP_HAS_CGI)
config CONFIG_SSL_PRIVATE_KEY_PASSWORD string
prompt CONFIG_SSL_PRIVATE_KEY_PASSWORD ( not CONFIG_SSL_USE_DEFAULT_KEY and CONFIG_SSL_HAS_PEM)
config CONFIG_WIN32_USE_CRYPTO_LIB bool
prompt CONFIG_WIN32_USE_CRYPTO_LIB (CONFIG_PLATFORM_WIN32)
bool_choice CONFIG_INTEGER_32BIT CONFIG_INTEGER_16BIT CONFIG_INTEGER_8BIT|( not CONFIG_SSL_SKELETON_MODE and 1)
bool_choice CONFIG_BIGINT_CLASSICAL CONFIG_BIGINT_MONTGOMERY CONFIG_BIGINT_BARRETT|( not CONFIG_SSL_SKELETON_MODE and 1)
bool_choice CONFIG_SSL_PROT_LOW CONFIG_SSL_PROT_MEDIUM CONFIG_SSL_PROT_HIGH|( not CONFIG_SSL_SKELETON_MODE and 1)
bool_choice CONFIG_SSL_SERVER_ONLY CONFIG_SSL_CERT_VERIFICATION CONFIG_SSL_ENABLE_CLIENT CONFIG_SSL_FULL_MODE CONFIG_SSL_SKELETON_MODE|(1)
bool_choice CONFIG_VISUAL_STUDIO_7_0 CONFIG_VISUAL_STUDIO_8_0 CONFIG_VISUAL_STUDIO_10_0|(CONFIG_PLATFORM_WIN32 and 1)
bool_choice CONFIG_PLATFORM_LINUX CONFIG_PLATFORM_CYGWIN CONFIG_PLATFORM_WIN32|(1)
dep CONFIG_HTTP_TIMEOUT (CONFIG_AXHTTPD)
dep CONFIG_SSL_X509_ORGANIZATION_NAME (CONFIG_SSL_GENERATE_X509_CERT)
dep CONFIG_SSL_SERVER_ONLY (1)
dep CONFIG_JAVA_HOME (CONFIG_JAVA_BINDINGS)
dep CONFIG_SSL_TEST (CONFIG_SSL_FULL_MODE and  not CONFIG_SSL_GENERATE_X509_CERT)
dep CONFIG_SSL_PROT_LOW (1)
dep CONFIG_DOT_NET_FRAMEWORK_BASE (CONFIG_CSHARP_BINDINGS or CONFIG_VBNET_BINDINGS)
dep CONFIG_HTTP_DIRECTORIES (CONFIG_AXHTTPD)
dep CONFIG_PERL_CORE (CONFIG_PERL_BINDINGS and CONFIG_PLATFORM_WIN32)
dep CONFIG_VBNET_SAMPLES (CONFIG_SAMPLES and CONFIG_VBNET_BINDINGS)
dep CONFIG_CSHARP_SAMPLES (CONFIG_SAMPLES and CONFIG_CSHARP_BINDINGS)
dep CONFIG_SSL_EXPIRY_TIME ( not CONFIG_SSL_SKELETON_MODE)
dep CONFIG_PERL_BINDINGS (CONFIG_BINDINGS)
dep CONFIG_PLATFORM_WIN32 (1)
dep CONFIG_SSL_MAX_CERTS (1)
dep CONFIG_AXTLSWRAP ( not CONFIG_PLATFORM_WIN32)
dep CONFIG_EXTRA_CFLAGS_OPTIONS (1)
dep CONFIG_BIGINT_BARRETT (1)
dep CONFIG_C_SAMPLES (CONFIG_SAMPLES)
dep CONFIG_BIGINT_CLASSICAL (1)
dep CONFIG_JAVA_SAMPLES (CONFIG_SAMPLES and CONFIG_JAVA_BINDINGS)
dep MUL_KARATSUBA_THRESH ( not CONFIG_SSL_SKELETON_MODE and CONFIG_BIGINT_KARATSUBA)
dep CONFIG_VISUAL_STUDIO_10_0_BASE (CONFIG_PLATFORM_WIN32 and CONFIG_VISUAL_STUDIO_10_0)
dep CONFIG_LUA_SAMPLES (CONFIG_SAMPLES and CONFIG_LUA_BINDINGS)
dep CONFIG_SSL_PROT_MEDIUM (1)
dep CONFIG_SSL_USE_PKCS12 ( not CONFIG_SSL_SKELETON_MODE)
dep CONFIG_X509_MAX_CA_CERTS ( not CONFIG_SSL_SERVER_ONLY and  not CONFIG_SSL_SKELETON_MODE)
dep CONFIG_VISUAL_STUDIO_8_0_BASE (CONFIG_PLATFORM_WIN32 and CONFIG_VISUAL_STUDIO_8_0)
dep PREFIX ( not CONFIG_PLATFORM_WIN32)
dep CONFIG_VISUAL_STUDIO_8_0 (1)
dep CONFIG_SSL_X509_CERT_LOCATION ( not CONFIG_SSL_GENERATE_X509_CERT and  not CONFIG_SSL_USE_DEFAULT_KEY and  not CONFIG_SSL_SKELETON_MODE)
dep CONFIG_VBNET_BINDINGS (CONFIG_BINDINGS)
dep CONFIG_SSL_FULL_MODE (1)
dep CONFIG_BIGINT_MONTGOMERY (1)
dep CONFIG_HTTP_PORT (CONFIG_AXHTTPD)
dep CONFIG_HTTP_HTTPS_PORT (CONFIG_AXHTTPD)
dep CONFIG_CSHARP_BINDINGS (CONFIG_BINDINGS)
dep CONFIG_HTTP_LUA_PREFIX (CONFIG_AXHTTPD and  not CONFIG_PLATFORM_WIN32 and CONFIG_HTTP_ENABLE_LUA)
dep CONFIG_SSL_SKELETON_MODE (1)
dep CONFIG_BIGINT_SQUARE ( not CONFIG_SSL_SKELETON_MODE)
dep CONFIG_USE_DEV_URANDOM ( not CONFIG_PLATFORM_WIN32)
dep CONFIG_PERL_SAMPLES (CONFIG_SAMPLES and CONFIG_PERL_BINDINGS)
dep CONFIG_HTTP_BUILD_LUA (CONFIG_AXHTTPD and  not CONFIG_PLATFORM_WIN32 and CONFIG_HTTP_ENABLE_LUA)
dep CONFIG_VISUAL_STUDIO_10_0 (1)
dep CONFIG_PERFORMANCE_TESTING (CONFIG_SSL_CERT_VERIFICATION)
dep SQU_KARATSUBA_THRESH ( not CONFIG_SSL_SKELETON_MODE and CONFIG_BIGINT_KARATSUBA and CONFIG_BIGINT_SQUARE)
dep CONFIG_EXTRA_LDFLAGS_OPTIONS (1)
dep CONFIG_STRIP_UNWANTED_SECTIONS ( not CONFIG_PLATFORM_WIN32 and  not CONFIG_DEBUG)
dep CONFIG_SSL_ENABLE_CLIENT (1)
dep CONFIG_SSL_USE_DEFAULT_KEY ( not CONFIG_SSL_SKELETON_MODE)
dep CONFIG_SSL_CERT_VERIFICATION (1)
dep CONFIG_HTTP_WEBROOT (CONFIG_AXHTTPD)
dep CONFIG_HTTP_STATIC_BUILD (CONFIG_AXHTTPD)
dep CONFIG_HTTP_SESSION_CACHE_SIZE (CONFIG_AXHTTPD)
dep CONFIG_HTTP_CGI_EXTENSIONS (CONFIG_AXHTTPD and  not CONFIG_PLATFORM_WIN32 and CONFIG_HTTP_HAS_CGI)
dep CONFIG_BIGINT_SLIDING_WINDOW ( not CONFIG_SSL_SKELETON_MODE)
dep CONFIG_VISUAL_STUDIO_7_0 (1)
dep CONFIG_BIGINT_KARATSUBA ( not CONFIG_SSL_SKELETON_MODE)
dep CONFIG_BIGINT_CRT ( not CONFIG_SSL_SKELETON_MODE)
dep CONFIG_HTTP_USER (CONFIG_AXHTTPD and CONFIG_HTTP_ENABLE_DIFFERENT_USER)
dep CONFIG_LUA_CORE (CONFIG_LUA_BINDINGS)
dep CONFIG_VISUAL_STUDIO_7_0_BASE (CONFIG_PLATFORM_WIN32 and CONFIG_VISUAL_STUDIO_7_0)
dep CONFIG_HTTP_HAS_CGI (CONFIG_AXHTTPD and  not CONFIG_PLATFORM_WIN32)
dep CONFIG_PERL_LIB (CONFIG_PERL_BINDINGS and CONFIG_PLATFORM_WIN32)
dep CONFIG_INTEGER_32BIT (1)
dep CONFIG_HTTP_HAS_IPV6 (CONFIG_AXHTTPD and  not CONFIG_PLATFORM_WIN32)
dep CONFIG_PLATFORM_CYGWIN (1)
dep CONFIG_SSL_PRIVATE_KEY_LOCATION ( not CONFIG_SSL_USE_DEFAULT_KEY and  not CONFIG_SSL_SKELETON_MODE)
dep CONFIG_LUA_BINDINGS (CONFIG_BINDINGS and  not CONFIG_PLATFORM_WIN32)
dep CONFIG_HTTP_HAS_AUTHORIZATION (CONFIG_AXHTTPD)
dep CONFIG_INTEGER_8BIT (1)
dep CONFIG_HTTP_ENABLE_LUA (CONFIG_AXHTTPD and  not CONFIG_PLATFORM_WIN32 and CONFIG_HTTP_HAS_CGI)
dep CONFIG_JAVA_BINDINGS (CONFIG_BINDINGS)
dep CONFIG_SSL_X509_ORGANIZATION_UNIT_NAME (CONFIG_SSL_GENERATE_X509_CERT)
dep CONFIG_HTTP_ENABLE_DIFFERENT_USER (CONFIG_AXHTTPD and  not CONFIG_PLATFORM_WIN32)
dep CONFIG_BIGINT_CHECK_ON ( not CONFIG_SSL_SKELETON_MODE)
dep CONFIG_INTEGER_16BIT (1)
dep CONFIG_SSL_X509_COMMON_NAME (CONFIG_SSL_GENERATE_X509_CERT)
dep CONFIG_PLATFORM_LINUX (1)
dep CONFIG_HTTP_IS_DAEMON (CONFIG_AXHTTPD and  not CONFIG_PLATFORM_WIN32)
dep CONFIG_SSL_PROT_HIGH (1)
dep CONFIG_HTTP_VERBOSE (CONFIG_AXHTTPD)
dep CONFIG_SSL_HAS_PEM ( not CONFIG_SSL_SKELETON_MODE)
dep CONFIG_HTTP_CGI_LAUNCHER (CONFIG_AXHTTPD and  not CONFIG_PLATFORM_WIN32 and CONFIG_HTTP_HAS_CGI)
dep CONFIG_SSL_PRIVATE_KEY_PASSWORD ( not CONFIG_SSL_USE_DEFAULT_KEY and CONFIG_SSL_HAS_PEM)
dep CONFIG_WIN32_USE_CRYPTO_LIB (CONFIG_PLATFORM_WIN32)
```
